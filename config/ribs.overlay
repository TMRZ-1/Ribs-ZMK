/ {
    compatible = "zmk,keyboard";

    matrix {
        row-gpios = <&gpio0 2 GPIO_ACTIVE_LOW>,
                    <&gpio0 3 GPIO_ACTIVE_LOW>,
                    <&gpio0 9 GPIO_ACTIVE_LOW>,
                    <&gpio0 21 GPIO_ACTIVE_LOW>;
        col-gpios = <&gpio0 4 GPIO_ACTIVE_LOW>,
                    <&gpio0 5 GPIO_ACTIVE_LOW>,
                    <&gpio0 6 GPIO_ACTIVE_LOW>,
                    <&gpio0 7 GPIO_ACTIVE_LOW>,
                    <&gpio0 8 GPIO_ACTIVE_LOW>,
                    <&gpio0 23 GPIO_ACTIVE_LOW>,
                    <&gpio0 20 GPIO_ACTIVE_LOW>,
                    <&gpio0 22 GPIO_ACTIVE_LOW>,
                    <&gpio0 26 GPIO_ACTIVE_LOW>,
                    <&gpio0 27 GPIO_ACTIVE_LOW>;
        diode-direction = "col2row";
    };
};
