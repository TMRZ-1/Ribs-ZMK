/ {
    compatible = "zmk,keyboard";

    chosen {
        zmk,kscan = &kscan0;
    };

    matrix_transform0: matrix-transform {
        compatible = "zmk,matrix-transform";
        rows = <4>;
        cols = <10>;
    };

    kscan0: kscan {
        compatible = "zmk,kscan-gpio";
        label = "KSCAN";
        diode-direction = "col2row";
        matrix-transform = <&matrix_transform0>;

        row-gpios = <&gpio0 17 GPIO_ACTIVE_LOW>,
                    <&gpio0 20 GPIO_ACTIVE_LOW>,
                    <&gpio0 7 GPIO_ACTIVE_LOW>,
                    <&gpio0 31 GPIO_ACTIVE_LOW>;

        col-gpios = <&gpio0 22 GPIO_ACTIVE_LOW>,
                    <&gpio0 24 GPIO_ACTIVE_LOW>,
                    <&gpio0 9 GPIO_ACTIVE_LOW>,
                    <&gpio0 10 GPIO_ACTIVE_LOW>,
                    <&gpio1 6 GPIO_ACTIVE_LOW>,
                    <&gpio0 2 GPIO_ACTIVE_LOW>,
                    <&gpio0 28 GPIO_ACTIVE_LOW>,
                    <&gpio0 4 GPIO_ACTIVE_LOW>,
                    <&gpio0 3 GPIO_ACTIVE_LOW>,
                    <&gpio0 6 GPIO_ACTIVE_LOW>; /* zamiana z 27 (duplikat) */
    };
};
