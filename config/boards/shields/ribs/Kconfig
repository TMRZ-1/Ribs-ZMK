## config/boards/shields/ribs/Kconfig.defconfig
```kconfig
# SPDX-License-Identifier: MIT

if SHIELD_ribs

config ZMK_KEYBOARD_NAME
    default "ribs"

endif
```

## config/west.yml
```yaml
manifest:
  version: 0.13

  defaults:
    remote: zmkfirmware

  remotes:
    - name: zmkfirmware
      url-base: https://github.com/TMRZ-1/Ribs-ZMK

  projects:
    - name: zmk
      path: zmk
      revision: main
      remote: zmkfirmware

  self:
    path: config
```
